/dts-v1/;
/plugin/;

#include <dt-bindings/input/input.h>
#include <dt-bindings/gpio/gpio.h>
#include <dt-bindings/gpio/meson-g12a-gpio.h>

/ {
        compatible = "radxa,zero", "amlogic,g12a";

        fragment@0 {
                target-path = "/";
                __overlay__ {
                        gpio-keys-polled {
                                compatible = "gpio-keys-polled";
                                poll-interval = <100>;

                                power-button {
                                        label = "power";
                                        linux,code = <KEY_POWER>;
                                        gpios = <&gpio_ao GPIOAO_4 (GPIO_ACTIVE_LOW)>;
                                };
                        };
                };
        };
};


